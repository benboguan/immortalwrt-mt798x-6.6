## package/mtk/applications/fwdd/Config.in
```kconfig
menu "Configuration"

config FWDD_DEFAULT_TARGET_BAND
        string "Support WPACTRL in wapp"

endmenu
```

## package/mtk/applications/wappd/Config.in
```kconfig
menu "Configuration"

config WAPP_WPACTRL_SUPPORT
	bool "Support WPACTRL in wapp"
	default n

endmenu
```

## package/network/utils/iwinfo/Config.in
```kconfig
menu "General Configuration"

config IWINFO_DOT11_EHT_BE
	bool "if wifi support 11be."
	default n
	help
		This is config for wifi 11be.

config IWINFO_BE_MAX_SKU_TYPE
	bool "wifi sku type be19000 or be14000."
	depends on IWINFO_DOT11_EHT_BE
	default n
	help
		This is config for wifi SKU_TYPE=BE19000 or SKU_TYPE=BE14000.

config IWINFO_MLO_SUPPORT
	bool "if support mlo rate display."
	depends on IWINFO_DOT11_EHT_BE
	default n
	help
		This is config for wifi7 mlo rate display.

endmenu
```
